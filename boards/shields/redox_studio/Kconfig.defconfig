## boards/shields/redox_studio/Kconfig.defconfig
```kconfig
# Copyright (c) 2021 The ZMK Contributors
# SPDX-License-Identifier: MIT
if SHIELD_REDOX_STUDIO_LEFT

config ZMK_KEYBOARD_NAME
    default "Redox_Studio"

config ZMK_SPLIT_ROLE_CENTRAL
    default y

endif

if SHIELD_REDOX_STUDIO_LEFT || SHIELD_REDOX_STUDIO_RIGHT

config ZMK_SPLIT
    default y

endif
```

## boards/shields/redox_studio/Kconfig.shield
```kconfig
# Copyright (c) 2021 The ZMK Contributors
# SPDX-License-Identifier: MIT
config SHIELD_REDOX_STUDIO_LEFT
    def_bool $(shields_list_contains,redox_studio_left)

config SHIELD_REDOX_STUDIO_RIGHT
    def_bool $(shields_list_contains,redox_studio_right)
```
